## drivers/gpu/drm/hisilicon/charlotte/Kconfig
```kconfig
# SPDX-License-Identifier: GPL-2.0-only
config DRM_CHARLOTTE_DPU
	tristate "Charlotte DPU v700 firmware-handoff KMS"
	depends on DRM && OF && ARM64 && I2C
	select DRM_GEM_DMA_HELPER
	select DRM_KMS_HELPER
	help
	  Native atomic KMS and DMA-buffer scanout for the DPU v700 on
	  Huawei TGR-W00. Retains the firmware's DSI/DSC/panel initialization.
	  Only the existing 1840x2800 scanout mode is supported initially.
	  The probe_only=1 parameter inspects the handoff without register
	  writes, interrupts or KMS takeover. Explicit debugfs diagnostics are
	  bounded and restore the interrupt mask. Build this driver into the
	  kernel on TGR: loadable module execution is not functional there yet.
```

## drivers/gpu/hvgr/Kconfig.charlotte
```kconfig
# SPDX-License-Identifier: GPL-2.0-only
config CHARLOTTE_HVGR
	bool "Charlotte HVGR v200 GPU (experimental)"
	depends on ARM64 && OF && REGULATOR && CHARLOTTE_FFA
	select HISI_GPU
	select HVGR_EXPERT
	select HVGR_V2XX
	select CRC16
	select DMA_SHARED_BUFFER
	select SYNC_FILE
	select CHARLOTTE_SECUREC
	help
	  Experimental port of the GPL HVGR v200 vendor command queue driver.
	  Uses the original device ABI, not the Panfrost/Panthor DRM ABI.

config HISI_GPU
	bool
config HVGR_EXPERT
	bool
config HVGR_V2XX
	bool
config HVGR_PLATFORM_NAME
	string
	default "p0000301"
```

## drivers/net/wireless/hisilicon/Kconfig
```kconfig
# SPDX-License-Identifier: GPL-2.0-only
config WLAN_VENDOR_HISILICON
	bool "HiSilicon wireless LAN devices"
	default y

if WLAN_VENDOR_HISILICON
config CHARLOTTE_HI11XX_WIFI
	bool "Charlotte Hi11xx vendor Wi-Fi port (experimental)"
	depends on ARM64 && PCI && MMC && GPIOLIB && CFG80211=y
	depends on PCIE_CHARLOTTE
	help
	  Work in progress port of the TGR-W00 vendor Hi11xx WLAN driver.
	  Requires the Charlotte PCIe host and board power implementation.
	  Leave disabled until the platform dependencies have been validated.
endif
```
